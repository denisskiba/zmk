## app/boards/arm/Model_0/Kconfig.board
```kconfig
# Wizard Keyboards Model 0 Configuration

# Copyright (c) 2020 The ZMK Contributors
# SPDX-License-Identifier: MIT

config BOARD_MODEL_0
	bool "model_0"
	depends on SOC_NRF52840_QIAA
```

## app/boards/arm/Model_0/Kconfig.defconfig
```kconfig
# Copyright (c) 2020 The ZMK Contributors
# SPDX-License-Identifier: MIT

if BOARD_MODEL_0

config BOARD
	default "model_0"

if USB

config USB_NRFX
	default y

config USB_DEVICE_STACK
	default y

endif # USB

config BT_CTLR
	default BT

config ZMK_BLE
	default y

config ZMK_USB
	default y

endif # BOARD_MODEL_0
```

## app/boards/arm/ergo_s-1/Kconfig.board
```kconfig
# Wizard Keyboards Model 0 Configuration

# Copyright (c) 2020 The ZMK Contributors
# SPDX-License-Identifier: MIT

config BOARD_ERGO_S-1
	bool "ergo_s-1"
	depends on SOC_NRF52840_QIAA
```

## app/boards/shields/ergo_s-1/Kconfig.defconfig
```kconfig
# Copyright (c) 2020 The ZMK Contributors
# SPDX-License-Identifier: MIT

if SHIELD_ERGO_S-1_LEFT

config ZMK_KEYBOARD_NAME
    default "Ergo S-1"

config ZMK_SPLIT_BLE_ROLE_CENTRAL
    default y

endif

if SHIELD_ERGO_S-1_RIGHT

config ZMK_KEYBOARD_NAME
    default "Ergo S-1 R"

endif

if SHIELD_ERGO_S-1_LEFT || SHIELD_ERGO_S-1_RIGHT

config ZMK_SPLIT
    default y

endif
```

## app/boards/shields/ergo_s-1/Kconfig.shield
```kconfig
# Copyright (c) 2020 The ZMK Contributors
# SPDX-License-Identifier: MIT

config SHIELD_ERGO_S-1_LEFT
    def_bool $(shields_list_contains,ergo_s-1_left)

config SHIELD_ergo_s-1_RIGHT
    def_bool $(shields_list_contains,ergo_s-1_right)
```

## app/boards/shields/model_0/Kconfig.defconfig
```kconfig
# Copyright (c) 2020 The ZMK Contributors
# SPDX-License-Identifier: MIT

if SHIELD_MODEL_0_LEFT

config ZMK_KEYBOARD_NAME
    default "Model 0 Keyboard"

config ZMK_SPLIT_BLE_ROLE_CENTRAL
    default y

endif

if SHIELD_MODEL_0_RIGHT

config ZMK_KEYBOARD_NAME
    default "Model 0 R"

endif

if SHIELD_MODEL_0_LEFT || SHIELD_MODEL_0_RIGHT

config ZMK_SPLIT
    default y

endif
```

## app/boards/shields/model_0/Kconfig.shield
```kconfig
# Copyright (c) 2020 The ZMK Contributors
# SPDX-License-Identifier: MIT

config SHIELD_MODEL_0_LEFT
    def_bool $(shields_list_contains,model_0_left)

config SHIELD_MODEL_0_RIGHT
    def_bool $(shields_list_contains,model_0_right)
```
